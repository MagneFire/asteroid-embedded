// SPDX-License-Identifier: GPL-3.0-or-later
/dts-v1/;

/ {
	#address-cells = <2>;
	#size-cells = <2>;
	model = "LG G Watch";
	compatible = "lge,dory", "qcom,apq8026";
	/* The retail boards, rev-10 and rev-11, with the chip ids the
	 * vendor's trees list for them. */
	qcom,msm-id = <199 0x20000>, <219 0x20000>, <200 0>, <224 0>, <200 0x10001>, <224 0x10001>;
	qcom,board-id = <131 0x0a>, <131 0x0b>;

	chosen { };
	aliases { };

	memory {
		device_type = "memory";
		reg = <0 0 0 0>;
	};
};
